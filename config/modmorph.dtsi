/*                             KEY POSITIONS
    ╭───────────────────────────╮           ╭────────────────────────────╮
    │ 0   1   2   3   4   5   6 │           │  7   8   9  10  10  12  13 │
    ╰──╮ 14  15  16  17  18  19 │           │ 20  21  22  23  24  25 ╭───╯
       │ 26  27  28  29  30  31 ╰───╮   ╭───╯ 32  33  34  35  36  37 │
       ╰───────────────╮ 38  39  40 │   │ 41  42  43 ╭───────────────╯
                       ╰────────────╯   ╰────────────╯
*/

#include <dt-bindings/zmk/keys.h>
#define str(s) #s

#define MOD_MORPH_SKIP_MOD(NAME, KEY, MOD_KEY, MODS) \
mm_##NAME: mm_##NAME {\
  compatible = "zmk,behavior-mod-morph";\
  label = str(NAME);\
  #binding-cells = <0>;\
  bindings = <&kp KEY>, <&kp MOD_KEY>;\
  mods = <MODS>;\
}; \

#define MOD_MORPH(NAME, KEY, MOD_KEY, MODS) \
mm_##NAME: mm_##NAME { \
  compatible = "zmk,behavior-mod-morph"; \
  label = str(NAME); \
  #binding-cells = <0>; \
  bindings = <&kp KEY>, <&kp MOD_KEY>; \
  mods = <MODS>; \
};

// vukeys top
// vukeys middle
// vukeys bottom
MOD_MORPH_SKIP_MOD(comma_semi, COMMA, SEMI, (MOD_LSFT|MOD_RSFT))
MOD_MORPH(dot_col, DOT, COLON, (MOD_LSFT|MOD_RSFT))
// sym top
MOD_MORPH_SKIP_MOD(pipe_bslh, PIPE, BACKSLASH, (MOD_LSFT|MOD_RSFT))
MOD_MORPH_SKIP_MOD(lbkt, LBKT, LBKT, (MOD_LSFT|MOD_RSFT))
MOD_MORPH(lpr_hash, LS(N9), LS(N3), (MOD_LSFT|MOD_RSFT))
MOD_MORPH(lcbr_dollar, LS(LBKT), LS(N4), (MOD_LSFT|MOD_RSFT))
MOD_MORPH(rcbr_amp, LS(RBKT), LS(N7), (MOD_LSFT|MOD_RSFT))
MOD_MORPH(rpr_star, LS(N0), LS(N8), (MOD_LSFT|MOD_RSFT))
MOD_MORPH(rbkt, RBKT, RBKT, (MOD_LSFT|MOD_RSFT))
// sym middle
MOD_MORPH_SKIP_MOD(n3_left, N3, LEFT, (MOD_LSFT|MOD_RSFT))
MOD_MORPH_SKIP_MOD(n4_right, N4, RIGHT, (MOD_LSFT|MOD_RSFT))
MOD_MORPH_SKIP_MOD(n7_down, N7, DOWN, (MOD_LSFT|MOD_RSFT))
MOD_MORPH_SKIP_MOD(n8_up, N8, UP, (MOD_LSFT|MOD_RSFT))
MOD_MORPH(n9_lt, N9, LESS_THAN, (MOD_LSFT|MOD_RSFT))
MOD_MORPH(n0_gt, N0, GREATER_THAN, (MOD_LSFT|MOD_RSFT))
// sym bottom

// ukraine
MOD_MORPH_SKIP_MOD(t_quot, T, SINGLE_QUOTE, (MOD_LSFT|MOD_RSFT))
MOD_MORPH_SKIP_MOD(s_rbkt, S, RBKT, (MOD_LSFT|MOD_RSFT))
MOD_MORPH_SKIP_MOD(u_grv, U, GRAVE, (MOD_LSFT|MOD_RSFT))
MOD_MORPH_SKIP_MOD(comma_bslh, COMMA, BSLH, (MOD_LSFT|MOD_RSFT))
MOD_MORPH_SKIP_MOD(shtfslash_bslash, LS(SLASH), BSLH, (MOD_LSFT|MOD_RSFT))
#undef MOD_MORPH_SKIP_MOD
#undef MOD_MORPH


th: tap_hold {
  compatible = "zmk,behavior-hold-tap";
  label = "tap hold";
  #binding-cells = <2>;
  tapping-term-ms = <200>;
  quick_tap_ms = <0>;
  flavor = "tap-preferred";
  bindings = <&kp>, <&kp>;
};
